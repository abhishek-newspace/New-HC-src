/**
 * @file displayHandler.cpp
 * @version 0.4
 * @author Abhishek
 * @date 21/09/2026
 * 
 * Part of displayHandler library.
 * Defines variables and functions used for displayHandler.h
 *
 * <h2>Changes</h2>
 * @date 15/07/2026
 * - SRS §3.2.2 connectivity LED priority (Red disconnected, Yellow low RSSI, Blue timesync, Green healthy)
 * - compact top-row UGV/HC battery gauges; fill width = SoC% from right; colour from SoC bands
 * - battery labels use dim grey + transparent glyphs so fill colour stays visible
 * - displayHcBatteryStatus(), drawBatteryGaugeFill(), triggerTactileAlert() for UGV low-battery (SRS §3.2.4)
 * - setBatterySOC accepts 0–100; HC gauge only redraws when SoC changes
 *
 * @date 22/07/2026
 * @author Abhishek
 * - UHF radio mode: show "CONNECTED TO UHF" when radio link is up but UGV/Atlas HB not yet
 *   received; replaced by "ATLAS AND RADIO CONNECTED" once UGV is connected
 *
 * @date 21/08/2026
 * @author Abhishek
 * - setDisplayBacklight() / showStartupLogo(): static NS logo with backlight off during paint
 * - removed invert/second-frame startup animation; brief STARTUP_LOGO_HOLD_MS hold only
 *
 * @date 21/09/2026
 * @author Abhishek
 * - Arm status colours: Disarmed = Solid Red, Armed = Solid Green (was Blue when disarmed)
 * - displayEstopStatus(): remote e-stop LED below connectivity LED (Engaged=Red / Disengaged=Green)
 */
#include "include/displayHandler.hpp"
#include "include/IOhandler.hpp"

#ifndef RELEASE_ARDUINO_UNO

extern struct buttons user_input;
extern ugv_status current_state;
extern ugv_status prev_state;
extern connectivity_status conn_stat;
connectivity_status prev_conn_stat = conn_invalid;

int currentErrorCodeDisplayed = -1;
int prevConnStatus = -1;
int16_t RSSI = 0, remRSSI = 0;
uint8_t ugv_battery_soc = 0;
bool radioConnected;

bool timesync_received = false;

uint8_t ugv_batt_ix = 0, ugv_batt_iy = 0;
uint8_t hc_batt_ix = 0, hc_batt_iy = 0;

String current_info_displayed = "";
String current_err_displayed = "";

void disconnectRadio(){
  radioConnected = false;
}

int getErrorCodeDisplayed(){
  return currentErrorCodeDisplayed;
}

void connectRadio(){
  radioConnected = true;
}

void triggerTactileAlert(){
#ifdef TACTILE_PIN
  // Brief pulse on dedicated haptic / buzzer pin (optional production HW).
  pinMode(TACTILE_PIN, OUTPUT);
  digitalWrite(TACTILE_PIN, HIGH);
  delay(120);
  digitalWrite(TACTILE_PIN, LOW);
#else
  // This remote revision has no tactile actuator wired — visual INFO band covers the alert.
  IF_DEBUG(Serial.println("tactile alert (UGV low battery) — no TACTILE_PIN defined");)
#endif
}

#ifdef PROTOTYPE
    TFT_22_ILI9225 tft = TFT_22_ILI9225(TFT_RST, TFT_RS, TFT_CS, TFT_SDI, TFT_CLK, TFT_LED, TFT_BRIGHTNESS);

    static const uint8_t PROGMEM ns_logo[] = 
    {
    0xff,0xff,0xff,0xff,0xff,0xff,0xff,0xff,0xff,0xff,0xff,0xff,0xff,0xff,0xff,0xff,0xff,0xff,0xff,0xff,0xff,0xff,
    0xff,0xff,0xff,0xff,0xff,0xff,0xff,0xff,0xff,0xff,0xff,0xff,0xff,0xff,0xff,0xff,0xff,0xff,0xff,0xff,0xff,0xff,
    0xff,0xff,0xff,0xff,0xff,0xff,0xff,0xff,0xff,0xff,0xff,0xff,0xff,0xff,0xff,0xff,0xff,0xff,0xff,0xff,0xff,0xff,
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    0xff,0xff,0xff,0xff,0xff,0xff,0xff,0xff,0xff,0xff,0xff,0xff,0xff,0xff,0xff,0xff,0xff,0xff,0xff,0xff,0xff,0xff
    };

#endif // IF_PROTOTYPE


void displayLogo(){
    tft.drawBitmap(0, 0, ns_logo, SCREEN_WIDTH, SCREEN_HEIGHT, COLOR_WHITE, COLOR_BLUE);
}

void displayInvertedLogo(){
    #ifdef DISPLAY_NS_LOGO
      tft.drawBitmap(0, 0, ns_logo, SCREEN_WIDTH, SCREEN_HEIGHT, COLOR_GRAY, COLOR_LIGHTBLUE);
    #else
      tft.fillRectangle(0, 0, SCREEN_WIDTH, SCREEN_HEIGHT, COLOR_BLACK);
    #endif
}

void setDisplayBacklight(bool on){
    tft.setBacklight(on);
}

void showStartupLogo(){
    // Soft SPI paints left→right / top→bottom; keep BL off so user only sees the finished frame.
    tft.setBacklight(false);
    displayLogo();
    tft.setBacklight(true);
    delay(STARTUP_LOGO_HOLD_MS);
    tft.setBacklight(false);
    clear_display();
}

void setFontSmall(){
  tft.setFont(Terminal6x8);
}
void setFont1(){
    tft.setFont(Terminal11x16);
}

void initDisplayComm()
{
    Serial.begin(LCD_DISPLAY_BAUD_RATE);
    tft.begin();
}

void clear_display(){
    tft.clear();
}

void displayUGV_status(ugv_status s){
  String text;
  int color;
  switch(s){
    case disconnected:
      text = "DISCONNECTED";
      color = COLOR_RED;
      ugv_battery_soc = 0;
      IF_DEBUG (Serial.println("disconnected");)
    break;
    case active:
      /* Arm status LED / text: Armed = Solid Green */
      text = "ARMED           ";
      color = COLOR_GREEN;
    break;
    case standby:
      /* Arm status LED / text: Disarmed = Solid Red (was Blue) */
      text = "DISARMED        ";
      color = COLOR_RED;
    break;
    default:
      text = "UNKOWN          ";
      color = COLOR_ORANGE;
  }
  tft.drawText(UGV_STATUS_TEXT_POS_X,UGV_STATUS_TEXT_POS_Y,text,color);
}

/**
 * Remote e-stop LED — mirrors UGV remote emergency from HEARTBEAT (SRS §3.3.1).
 * Engaged = Solid Red; Disengaged = Solid Green; Disabled = Gray.
 */
void displayEstopStatus(estopMode mode){
  static int prev = -1;
  if((int)mode == prev)
    return;
  prev = (int)mode;

  int color = ESTOP_COLOR_DISENGAGED;
  switch(mode){
    case engaged:
      color = ESTOP_COLOR_ENGAGED;
      break;
    case disengaged:
      color = ESTOP_COLOR_DISENGAGED;
      break;
    case disabled:
      color = ESTOP_COLOR_DISABLED;
      break;
    default:
      color = ESTOP_COLOR_DISABLED;
      break;
  }

  tft.fillRectangle(
      ESTOP_STAT_MSG_POS_X,
      ESTOP_STAT_MSG_POS_Y,
      ESTOP_STAT_MSG_POS_X + ESTOP_STAT_MSG_SZ_X,
      ESTOP_STAT_MSG_POS_Y + ESTOP_STAT_MSG_SZ_Y,
      color);
}

void displaySpeed(int speed){
  String text;
  int color;
  switch(speed + 1){
    case 0:
      text = "RESERVED  ";
      color = DEFAULT_TEXT_COLOR;
    break;
    case 1:
      text = "LOW       ";
      color = COLOR_GREEN;
    break;
    case 2:
      text = "MEDIUM    ";
      color = COLOR_YELLOW;
    break;
    case 3:
      text = "HIGH      ";
      color = COLOR_RED;
      break;
  }
  tft.drawText(SPEED_TEXT_POS_X,SPEED_TEXT_POS_Y,text, color);  
}


void displayRSSI(){
  String rssiStr = String(RSSI);
  if(RSSI > -100)
    rssiStr = String(RSSI) + String("        ");
  // else if(RSSI < 10){
  //   rssiStr = String("00") + String(RSSI);
  // }
  // else if(RSSI == 0)
  //   radioConnected = false;
  if(radioConnected)
    tft.drawText(RSSI_TEXT_POS_X, RSSI_TEXT_POS_Y, rssiStr, DEFAULT_TEXT_COLOR);
  else
     tft.drawText(RSSI_TEXT_POS_X, RSSI_TEXT_POS_Y, "      ", DEFAULT_TEXT_COLOR);
}


static int ugvBatteryColor(uint8_t soc){
    if(soc > 40)
      return COLOR_GREEN;
    if(soc > 30)
      return COLOR_YELLOW;
    return COLOR_RED;
}

static int hcBatteryColor(uint8_t soc){
    if(soc > 40)
      return COLOR_GREEN;
    if(soc > 20)
      return COLOR_YELLOW;
    return COLOR_RED;
}

/** Fill right-to-left: coloured width = soc% of BATTERY_LENGTH (empty on left). */
static void drawBatteryGaugeFill(uint8_t ix, uint8_t iy, uint8_t soc, int fillColor){
    const uint8_t clamped = (soc > 100) ? 100 : soc;
    const int fillW = (BATTERY_LENGTH * clamped) / 100;
    const int fillStart = ix + BATTERY_LENGTH - fillW;

    tft.fillRectangle(ix, iy, ix + BATTERY_LENGTH, iy + BATTERY_HEIGHT, BATTERY_BG_COLOR);
    if(clamped > 0 && fillW > 0)
      tft.fillRectangle(fillStart, iy, ix + BATTERY_LENGTH, iy + BATTERY_HEIGHT, fillColor);
}

/**
 * Draw battery label without opaque glyph background so SoC fill stays visible
 * through letter interiors (TFT_22_ILI9225 drawText always paints _bgColor).
 */
static void drawBatteryLabel(uint8_t x, uint8_t y, const char *text){
    setFontSmall();
    const _currentFont cf = tft.getFont();
    uint8_t cursor_x = x;

    for(const char *p = text; *p != '\0'; p++){
        const uint16_t ch = (uint16_t)(uint8_t)(*p);
        uint16_t charOffset = (cf.width * cf.nbrows) + 1;
        charOffset = (charOffset * (ch - cf.offset)) + FONT_HEADER_SIZE;

        uint8_t charWidth;
        if(cf.monoSp)
            charWidth = cf.width;
        else
            charWidth = pgm_read_byte(&cf.font[charOffset]);
        charOffset++;

        for(uint8_t i = 0; i < charWidth; i++){
            uint8_t h = 0;
            for(uint8_t j = 0; j < cf.nbrows; j++){
                const uint8_t charData = pgm_read_byte(&cf.font[charOffset++]);
                for(uint8_t k = 0; k < 8; k++){
                    if(h >= cf.height)
                        break;
                    if(bitRead(charData, k))
                        tft.drawPixel(cursor_x + i, y + (j * 8) + k, BATTERY_LABEL_COLOR);
                    h++;
                }
            }
        }
        cursor_x = (uint8_t)(cursor_x + charWidth + 1);
    }
}

void displayBattery(){
    /**
     * SRS §3.2.4 — UGV SoC fill colour (compact top-row gauge):
     *   Green  : > 40%
     *   Yellow : > 30% and <= 40%
     *   Red    : <= 30%
     */
    drawBatteryGaugeFill(ugv_batt_ix, ugv_batt_iy, ugv_battery_soc, ugvBatteryColor(ugv_battery_soc));
    drawBatteryLabel(ugv_batt_ix + 2, ugv_batt_iy + 1, "UGV");

    // Edge-trigger tactile once when SoC enters the red band (SRS §3.2.4).
    static bool was_in_low_band = false;
    bool in_low_band = (ugv_battery_soc > 0 && ugv_battery_soc <= 30);
    if(in_low_band && !was_in_low_band){
      triggerTactileAlert();
      displayInfo("UGV battery low; charge Scout");
    }
    else if(!in_low_band && was_in_low_band){
      clearInfo();
    }
    was_in_low_band = in_low_band;
}

void setRSSI(int16_t curr_RSSI){
  RSSI = curr_RSSI;
}
void setRemRSSI(uint16_t curr_remRSSI){
  remRSSI = curr_remRSSI;
}

void setBatterySOC(uint8_t batterySOC){
  IF_DEBUG(Serial.print("current soc : ");)
  IF_DEBUG(Serial.println(batterySOC);)
  if(batterySOC <= 100)
    ugv_battery_soc = batterySOC;
}

/**
 * SRS §3.2.2 — evaluate connectivity LED with explicit priority:
 *   Red:    UGV not connected / disconnected (must be Red per SRS + field observation)
 *   Blue:   timesync fault (while UGV link otherwise up)
 *   Yellow: RSSI below threshold (while connected)
 *   Green:  fully healthy link
 *   Orange: reserved for soft HB lag only (radio up, UGV state not yet marked disconnected)
 */
void displayConnectionStatus(){
  setFontSmall();

  // Status text line (informational; LED colour follows priority below).
  if(radioConnected && current_state != disconnected){
    /* UGV/Atlas HB accepted — clear any UHF-only debug text. */
    if(prevConnStatus != 2){
      tft.drawText(CONNECTED_MSG_POS_X, CONNECTED_MSG_POS_Y, "ATLAS AND RADIO  ", CONNECTED_COLOR);
      tft.drawText(CONNECTED_MSG_POS_X, CONNECTED_MSG_POS_Y + 8, "CONNECTED  ", CONNECTED_COLOR);
    }
    prevConnStatus = 2;
  }
  else if(radioConnected && current_state == disconnected){
    /*
     * Local RFD / UHF peer up (RADIO_STATUS remrssi > 0) but no valid COMP_HEARTBEAT yet.
     * UHF mode: show radio-up for bring-up debug. LED stays Red (not connected to UGV).
     */
    if(prevConnStatus != 1){
#ifndef RADIO_SIMULATION_TESTING
      tft.drawText(CONNECTED_MSG_POS_X, CONNECTED_MSG_POS_Y, "CONNECTED TO UHF ", RADIO_CONNECTED_COLOR);
      tft.drawText(CONNECTED_MSG_POS_X, CONNECTED_MSG_POS_Y + 8, "                 ", RADIO_CONNECTED_COLOR);
#else
      tft.drawText(CONNECTED_MSG_POS_X, CONNECTED_MSG_POS_Y, "UGV DISCONNECTED ", DISCONNECTED_COLOR);
      tft.drawText(CONNECTED_MSG_POS_X, CONNECTED_MSG_POS_Y + 8, "                 ", CONNECTED_COLOR);
#endif
    }
    prevConnStatus = 1;
  }
  else if(prevConnStatus != 0){
    tft.drawText(CONNECTED_MSG_POS_X, CONNECTED_MSG_POS_Y, "ALL DISCONNECTED", DISCONNECTED_COLOR);
    tft.drawText(CONNECTED_MSG_POS_X, CONNECTED_MSG_POS_Y + 8, "                 ", CONNECTED_COLOR);
    prevConnStatus = 0;
  }

  setFont1();

  // --- Priority-ordered LED state (SRS §3.2.2) ---
  // Field observation: UGV disconnected must show Red, not Yellow/Orange.
  connectivity_status led_stat;
  if(current_state == disconnected || !radioConnected){
    led_stat = all_disconnected;                 // Red — not connected to UGV
  }
  else if(!timesync_received){
    led_stat = comm_fault;                       // Blue — timesync error
  }
  else if(remRSSI < RSSI_WEAK_THRESHOLD_DBM || RSSI < RSSI_WEAK_THRESHOLD_DBM){
    // Yellow only when UGV is actually connected but link quality is poor.
    led_stat = low_connectivity;
  }
  else{
    led_stat = connected;                        // Green
  }

  conn_stat = led_stat;

  if(conn_stat != prev_conn_stat){
    IF_DEBUG(Serial.print("conn LED -> ");)
    IF_DEBUG(Serial.println((int)conn_stat);)
    int LED_color = COLOR_RED;
    switch(conn_stat){
      case connected:
        LED_color = COLOR_GREEN;
        break;
      case all_disconnected:
        LED_color = COLOR_RED;
        break;
      case low_connectivity:
        LED_color = COLOR_YELLOW;
        break;
      case comm_fault:
        LED_color = COLOR_BLUE;
        break;
      case only_radio_connected:
        // Soft "radio only" — still treat as not connected to UGV → Red
        LED_color = COLOR_RED;
        break;
      default:
        LED_color = COLOR_RED;
        break;
    }
    tft.fillRectangle(CONN_STAT_MSG_POS_X, CONN_STAT_MSG_POS_Y, CONN_STAT_MSG_POS_X + CONN_STAT_MSG_SZ_X, CONN_STAT_MSG_POS_Y + CONN_STAT_MSG_SZ_Y, LED_color);
  }

  prev_conn_stat = conn_stat;
}



void displayDriveMode(driveMode mode){
  setFontSmall();
  /* Text colour mirrors drive-mode LED: Speed=Green, Torque=Blue, Torque+SL=Orange */
  if(mode == speed)
    tft.drawText(DM_POS_X, DM_POS_Y, "SPEED  MODE", DM_COLOR_SPEED);
  else if(mode == torque)
    tft.drawText(DM_POS_X, DM_POS_Y, "TORQUE MODE", DM_COLOR_TORQUE);
  else
    tft.drawText(DM_POS_X, DM_POS_Y, "TRQ SL MODE", DM_COLOR_TORQUE_SL);
  setFont1();
}

void updateDisplay(){
    static int prevRSSI = 0, prevBattery = 0, prevHcBattery = -1;

    displayConnectionStatus();
    if(RSSI != prevRSSI)
      displayRSSI();
    if(ugv_battery_soc != prevBattery)
      displayBattery();

    const uint8_t hcSoc = readHcBatterySoc();
    if((int)hcSoc != prevHcBattery)
      displayHcBatteryStatus();

    prevRSSI = RSSI;
    prevBattery = ugv_battery_soc;
    prevHcBattery = hcSoc;
}


void displayInfo(String message){
  if(current_info_displayed == message)
    return;
  current_info_displayed = message;
  clearInfo();
  setFontSmall();
  if(message.length() > 23){
    tft.drawText(INFO_MSG_POS_X ,INFO_MSG_POS_Y, String("INFO:" + message.substring(0,22)),COLOR_YELLOW);
    tft.drawText(INFO_MSG_POS_X ,INFO_MSG_POS_Y + 8, String(message.substring(22)), COLOR_YELLOW);
  }
  else{
    tft.drawText(INFO_MSG_POS_X ,INFO_MSG_POS_Y , String("INFO:" + message), COLOR_YELLOW);
  }
  setFont1();
  


    // do{
    //     checkUserInput();
    // }while(user_input.arm_disarm == 0);
}

void clearInfo(){
  tft.fillRectangle(INFO_MSG_POS_X, INFO_MSG_POS_Y, INFO_MSG_POS_X1, INFO_MSG_POS_Y1, BACKGROUND_COLOR);
}

void displayError(String message, int error_code){
  if(message == current_err_displayed)
    return;
  current_err_displayed = message;
  currentErrorCodeDisplayed = error_code;

  tft.drawText(0,150, String("ERROR : " + String(error_code)), ERROR_TEXT_COLOR);
  setFontSmall();

  if(message.length() > 27){
    tft.drawText(0,170, message.substring(0,27), ERROR_TEXT_COLOR);
    tft.drawText(0,178, message.substring(27), ERROR_TEXT_COLOR);
  }
  else{
    tft.drawText(0,170, message, ERROR_TEXT_COLOR);
  }
  setFont1();
}
void clearError(){
  tft.fillRectangle(ERROR_MSG_POS_X, ERROR_MSG_POS_Y, ERROR_MSG_POS_X1, ERROR_MSG_POS_Y1, BACKGROUND_COLOR);
}

void displayDirection(directionToggle direction){
  static short int prevDirection = -1;
  if(direction == prevDirection)
    return;
  String text;
  switch(direction){
    case forward:
      text = "FORWARD";
    break;
    case reverse:
      text = "REVERSE";
    break;
    case neutral:
      text = "NEUTRAL";
    break;
  }
  tft.drawText(DIRN_POS_TEXT_X, DIRN_POS_TEXT_Y, text, DEFAULT_TEXT_COLOR);
  prevDirection = direction;
}

static void drawSmallBatteryOutline(int topLeftX, int topLeftY, uint8_t *innerX, uint8_t *innerY){
    *innerX = topLeftX + BATTERY_TIP_WIDTH + BATTERY_RECTANGLE_THICKNESS;
    *innerY = topLeftY + BATTERY_RECTANGLE_THICKNESS;

    for(int i = 1; i <= BATTERY_RECTANGLE_THICKNESS; i++)
      tft.drawRectangle(
        topLeftX + BATTERY_TIP_WIDTH + BATTERY_RECTANGLE_THICKNESS - i,
        topLeftY + BATTERY_RECTANGLE_THICKNESS - i,
        topLeftX + BATTERY_TIP_WIDTH + BATTERY_LENGTH + BATTERY_RECTANGLE_THICKNESS + i,
        topLeftY + BATTERY_HEIGHT + BATTERY_RECTANGLE_THICKNESS + i,
        BATTERY_COLOR);

    tft.fillRectangle(
        topLeftX,
        topLeftY + BATTERY_HEIGHT/4 + BATTERY_RECTANGLE_THICKNESS,
        topLeftX + BATTERY_TIP_WIDTH,
        topLeftY + (BATTERY_HEIGHT * 3) / 4 + BATTERY_RECTANGLE_THICKNESS,
        BATTERY_COLOR);
}

void displayBasic(){
    tft.setBackgroundColor(BACKGROUND_COLOR);
    
    tft.drawText(Y_OFFSET, UGV_STATUS_POS_X, "UGV STATUS:",DEFAULT_TEXT_COLOR);
    tft.drawText(Y_OFFSET, SPEED_POS_X, "SPEED:", DEFAULT_TEXT_COLOR);
    tft.drawText(Y_OFFSET, RSSI_POS_X, "RSSI:", DEFAULT_TEXT_COLOR);
    // tft.drawText(Y_OFFSET, DIRN_POS_X, "DIRN:", DEFAULT_TEXT_COLOR);

    /* Top row: mode (via displayDriveMode) + compact UGV/HC battery boxes */
    drawSmallBatteryOutline(UGV_BATTERY_POS_X, UGV_BATTERY_POS_Y, &ugv_batt_ix, &ugv_batt_iy);
    drawSmallBatteryOutline(HC_BATTERY_POS_X, HC_BATTERY_POS_Y, &hc_batt_ix, &hc_batt_iy);
    displayBattery();
    displayHcBatteryStatus();

    /* E-stop LED under connectivity LED; small "E" marker (does not overlap status text). */
    setFontSmall();
    tft.drawText(ESTOP_LABEL_POS_X, ESTOP_LABEL_POS_Y, "E", DEFAULT_TEXT_COLOR);
    setFont1();
    displayEstopStatus(disengaged);
}

/**
 * SRS §3.2.3.3 — HC pack compact gauge (top row), label "HC" inside:
 *   Green  : > 40%
 *   Yellow : > 20% and <= 40%
 *   Red    : > 10% and <= 20% (also 5–10%)
 *   Off    : < 5%
 */
void displayHcBatteryStatus(){
    const uint8_t soc = readHcBatterySoc();
    bool led_on = true;
    uint8_t shown = soc;
    int color = BATTERY_BG_COLOR;

    if(soc < 5){
        led_on = false;
        shown = 0;
        color = BATTERY_BG_COLOR;
    }
    else{
        color = hcBatteryColor(soc);
    }

    drawBatteryGaugeFill(hc_batt_ix, hc_batt_iy, shown, color);
    drawBatteryLabel(hc_batt_ix + 6, hc_batt_iy + 1, "HC");

#ifdef HC_BATT_STATUS_LED_PIN
    digitalWrite(HC_BATT_STATUS_LED_PIN, led_on ? HIGH : LOW);
#else
    (void)led_on;
#endif

    IF_DEBUG(Serial.print("HC batt SoC=");)
    IF_DEBUG(Serial.println(soc);)
}

#else


/// @brief clear LCD display
void clear_display(){}


/// @brief display error message and confirm with user whether to proceed or wait
void displayError(String message, int error_code){}

/// @brief display info message and wait for any user input to continue execution
void displayInfo(String message){}

/// initialize display communications (serial baud rate)
void initDisplayComm(){}

/// @brief update UGV status dislay
void displayUGV_status(ugv_status){}

/// @brief update speed display
void displaySpeed(int speed){}

/// @brief update RSSI stat display
void displayRSSI(){}

/// update battery stat display
void displayBattery(){}

void displayHcBatteryStatus(){}

void displayEstopStatus(estopMode){}

/// @brief set the screen with symbols/text that is required to understand the output of the display updates
void displayBasic(){}

/// @brief display newspace logo in white background and blue foreground colors
void displayLogo(){}

/// @brief display newspace logo in grey background and light blue foreground (to look like an translucent grey film filter)
void displayInvertedLogo(){}

void setDisplayBacklight(bool){}
void showStartupLogo(){}

void setBatterySOC(uint8_t){}
void setRSSI(int16_t){}

/**
 * this function is meant to be called once every 1 second, and only updates RSSI, and battery stats.
 * call displaySpeed() and displayUGV_status() separately when the values are updated (must be event based, and not periodic)
 */
void updateDisplay(){}

/// @brief set font style to 1
void setFont1(){}

/// @brief clear all info that is displayed
void clearInfo(){}


/// @brief clear displayed error
void clearError(){}


/// @brief writes direction onto screen
/// @param direction current direction
void displayDirection(directionToggle direction){}

/// @brief set radio status to disconnected
void disconnectRadio(){}

/// @brief set radio status to connected
void connectRadio(){}

/// @brief update the display for drive mode
/// @param mode speed / torque
void displayDriveMode(driveMode mode){}

#endif